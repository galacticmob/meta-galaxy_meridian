## build/conf/bblayers.conf
```bitbake
# OPIE DOES NOT WORK
# LAYER_CONF_VERSION is increased each time build/conf/bblayers.conf
# changes incompatibly
LCONF_VERSION = "6"

BBPATH = "${TOPDIR}"
BBFILES ?= ""

BBLAYERS ?= " \
  /root/meta-galaxy/meta \
  /root/meta-galaxy/meta-yocto \
  /root/meta-galaxy/meta-yocto-bsp \
  /root/meta-ghackndev \
  /root/meta-galaxy/meta-openembedded/meta-initramfs \
  /root/meta-galaxy/meta-openembedded/meta-python \
  /root/meta-galaxy/meta-openembedded/meta-oe \
  /root/meta-galaxy/openembedded-core/meta \
  "

BBLAYERS_NON_REMOVABLE ?= " \
  /root/meta-galaxy/meta \
  /root/meta-galaxy/meta-yocto \
  "
```
